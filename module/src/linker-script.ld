OUTPUT_FORMAT("binary");

code_lma = 4M;
data_lma = 12M;

SECTIONS
{
/*-----------------------------------------------*/
/*-----------------code segment------------------*/
/*-----------------------------------------------*/
/*-----------------------------------------------*/
	code_offset = 0x0;
	. = code_lma;
	.text : AT(code_offset) {
		*(.text)
	}
	. = ALIGN(16);
	code_size = . - code_lma;

/*-----------------------------------------------*/
/*-----------------data segment------------------*/
/*-----------------------------------------------*/
/*-----------------------------------------------*/
	data_offset = code_size;
    	. = data_lma;
	.data : AT(data_offset) {
		*(.data)
		*(.rodata)
		*(.bss)
		*(COMMON)
	}
	. = ALIGN(16);
	data_size = . - data_lma;

/*-----------------------------------------------*/
/*-------------discarded sections----------------*/
/*-----------------------------------------------*/
/*-----------------------------------------------*/

	/DISCARD/ : {
		*(.comment)
	}
}
